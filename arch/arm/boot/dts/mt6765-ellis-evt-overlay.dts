/* Copyright (c) 2019, Motorola Mobility Inc. All rights reserved.
 *
 * This program is free software; you can redistribute it and/or modify
 * it under the terms of the GNU General Public License version 2 and
 * only version 2 as published by the Free Software Foundation.
 *
 * This program is distributed in the hope that it will be useful,
 * but WITHOUT ANY WARRANTY; without even the implied warranty of
 * MERCHANTABILITY or FITNESS FOR A PARTICULAR PURPOSE.  See the
 * GNU General Public License for more details.
 */

/dts-v1/;
/plugin/;

#include "mt6765-ellis-common-overlay.dtsi"
/* Board match root node */
/ {
	fragment@model {
		target-path = "/";
		__overlay__ {
			mot,model = "ellis";
			mot,board-id = <0x41 0xA200>;
		};
	};
};

&rt1711_typec {
       rt-tcpc,vconn_supply  = <0>;
       charger = <&mtk_charger_type>;
       rt1711pd,intr_gpio = <&pio 42 0x0>;
       rt1711pd,intr_gpio_num = <42>;
};

&sgm7220_typec {
	sgm7220,intr_gpio = <&pio 42 0x1>;
	sgm7220,intr_gpio_num = <42>;

	/delete-property/ sgm7220,en_gpio;
};

#include <ellis_evt/cust.dtsi>
/*End of this file, DO NOT ADD ANYTHING HERE*/
